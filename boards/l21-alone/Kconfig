## boards/l21-alone/Kconfig
```kconfig
config BOARD
    default "l21-alone" if BOARD_L21_ALONE

config BOARD_L21_ALONE
    bool
    default y
    select CPU_MODEL_SAML21J18B
    select HAS_PERIPH_ADC
    select HAS_PERIPH_I2C
    select HAS_PERIPH_RTC
    select HAS_PERIPH_RTT
    select HAS_PERIPH_SPI
    select HAS_PERIPH_TIMER
    select HAS_PERIPH_UART
    select HAS_RIOTBOOT

    select HAVE_SAUL_GPIO
```

## pkg/driver_bme68x/Kconfig
```kconfig
# Copyright (c) 2020 HAW Hamburg
#
# This file is subject to the terms and conditions of the GNU Lesser
# General Public License v2.1. See the file LICENSE in the top level
# directory for more details.
#

config PACKAGE_DRIVER_BME68x
    bool
    depends on TEST_KCONFIG
    depends on MODULE_BME68x
    select MODULE_DRIVER_BME68x_CONTRIB
    select MODULE_ZTIMER
    select MODULE_ZTIMER_MSEC
    help
      BME68x sensor library, written and maintained by Bosch Sensortec. This is
      needed by RIOT BME68x driver.

config MODULE_DRIVER_BME68x_CONTRIB
    bool
    depends on TEST_KCONFIG
    help
        RIOT integration code for the BME68x package.
```
